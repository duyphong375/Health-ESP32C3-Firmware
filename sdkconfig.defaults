## sdkconfig.defaults
```kconfig
# Target
CONFIG_IDF_TARGET="esp32c3"
CONFIG_ESPTOOLPY_FLASHSIZE_4MB=y

# Custom partition table for RainMaker (OTA + secure cert + factory NVS)
CONFIG_PARTITION_TABLE_CUSTOM=y
CONFIG_PARTITION_TABLE_CUSTOM_FILENAME="partitions.csv"
CONFIG_PARTITION_TABLE_OFFSET=0xc000

# BLE Provisioning via NimBLE (ESP32-C3 only supports BLE, not Bluedroid)
CONFIG_BT_ENABLED=y
CONFIG_BT_NIMBLE_ENABLED=y

# mbedTLS optimization (save RAM on ESP32-C3)
CONFIG_MBEDTLS_DYNAMIC_BUFFER=y
CONFIG_MBEDTLS_DYNAMIC_FREE_PEER_CERT=y
CONFIG_MBEDTLS_DYNAMIC_FREE_CONFIG_DATA=y
CONFIG_MBEDTLS_CERTIFICATE_BUNDLE_DEFAULT_CMN=y

# FreeRTOS timer stack (required by RainMaker)
CONFIG_FREERTOS_TIMER_TASK_STACK_DEPTH=3120

# RainMaker security
CONFIG_ESP_RMAKER_USER_ID_CHECK=y

# Application Rollback for safe OTA
CONFIG_BOOTLOADER_APP_ROLLBACK_ENABLE=y
```
